## board/uniwest/evi/Kconfig
```kconfig
if TARGET_EVI

config SYS_BOARD
	default "evi"

config SYS_VENDOR
	default "uniwest"

config SYS_CONFIG_NAME
	default "evi"

endif
```

## configs/evi_defconfig
```kconfig
CONFIG_ARM=y
CONFIG_ARCH_MX6=y
CONFIG_TARGET_EVI=y
CONFIG_SYS_EXTRA_OPTIONS="IMX_CONFIG=board/uniwest/evi/evi.cfg,MX6Q"
# CONFIG_CMD_IMLS is not set
# CONFIG_CMD_FLASH is not set
CONFIG_CMD_GPIO=y
CONFIG_SPI_FLASH=y
```
